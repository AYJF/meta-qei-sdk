## conf/layer.conf
```bitbake
# We have a conf and classes directory, add to BBPATH
BBPATH .= ":${LAYERDIR}"

# We have recipes-* directories, add to BBFILES
BBFILES += "${LAYERDIR}/recipes-*/*/*.bb \
            ${LAYERDIR}/recipes-*/*/*.bbappend"

BBFILE_COLLECTIONS += "meta-qei-sdk"
BBFILE_PATTERN_meta-qei-sdk = "^${LAYERDIR}/"
BBFILE_PRIORITY_meta-qei-sdk = "9"

LAYERSERIES_COMPAT_meta-qei-sdk = "kirkstone"

BBFILES_DYNAMIC += " \
    qt5-layer:${LAYERDIR}/dynamic-layers/qt5-layer/*/*/*.bb \
    qt5-layer:${LAYERDIR}/dynamic-layers/qt5-layer/*/*/*.bbappend \
    \
    qt6-layer:${LAYERDIR}/dynamic-layers/qt6-layer/*/*/*.bb \
    qt6-layer:${LAYERDIR}/dynamic-layers/qt6-layer/*/*/*.bbappend \
    \
    freescale-distro:${LAYERDIR}/dynamic-layers/freescale-distro/*/*/*.bb \
    freescale-distro:${LAYERDIR}/dynamic-layers/freescale-distro/*/*/*.bbappend \
    \
    fsl-bsp-release:${LAYERDIR}/dynamic-layers/fsl-bsp-release/*/*/*.bb \
    fsl-bsp-release:${LAYERDIR}/dynamic-layers/fsl-bsp-release/*/*/*.bbappend \
    \
    fsl-bsp-release:${LAYERDIR}/dynamic-layers/fsl-sdk-release/*/*/*.bb \
    fsl-bsp-release:${LAYERDIR}/dynamic-layers/fsl-sdk-release/*/*/*.bbappend \
    \
    chromium-browser-layer:${LAYERDIR}/dynamic-layers/chromium-browser-layer/*/*/*.bb \
    chromium-browser-layer:${LAYERDIR}/dynamic-layers/chromium-browser-layer/*/*/*.bbappend \
"
```
